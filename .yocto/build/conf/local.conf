## .yocto/build/conf/local.conf
```bitbake
MACHINE ??= "raspberrypi4-64"

IMAGE_INSTALL:append = "\
    example \
    openssh \
"

DISTRO_FEATURES:append = " wayland pam"
CORE_IMAGE_EXTRA_INSTALL += " wayland weston python3 python3-pip python3-pyside6 qtwayland"
IMAGE_ROOTFS_SIZE = "5242880"
# ------------------------------------------
DISTRO ?= "poky"

PACKAGE_CLASSES ?= "package_rpm"

EXTRA_IMAGE_FEATURES ?= "debug-tweaks"

USER_CLASSES ?= "buildstats"

PATCHRESOLVE = "noop"

BB_DISKMON_DIRS ??= "\
    STOPTASKS,${TMPDIR},1G,100K \
    STOPTASKS,${DL_DIR},1G,100K \
    STOPTASKS,${SSTATE_DIR},1G,100K \
    STOPTASKS,/tmp,100M,100K \
    HALT,${TMPDIR},100M,1K \
    HALT,${DL_DIR},100M,1K \
    HALT,${SSTATE_DIR},100M,1K \
    HALT,/tmp,10M,1K"

BB_NUMBER_THREADS = '2'
PARALLEL_MAKE = '-j 2'

PACKAGECONFIG:append:pn-qemu-system-native = " sdl"

CONF_VERSION = "2"
```
